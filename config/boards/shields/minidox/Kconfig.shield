## config/boards/shields/minidox/Kconfig.shield
```kconfig
config SHEIELD_MINIDOX_LEFT
	def_bool $(shields_list_contains,minidox_left)

config SHEIELD_MINIDOX_RIGHT
	def_bool $(shields_list_contains,minidox_right)
```
